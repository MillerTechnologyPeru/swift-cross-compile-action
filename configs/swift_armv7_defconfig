## configs/swift_armv7_defconfig
```kconfig
# Armv7
BR2_arm=y
BR2_cortex_a8=y
BR2_ARM_FPU_VFPV3=y

# GNU C Toolchain
BR2_KERNEL_HEADERS_4_9=y
BR2_TOOLCHAIN_BUILDROOT_GLIBC=y
BR2_TOOLCHAIN_BUILDROOT_CXX=y

# Vendor
BR2_TOOLCHAIN_BUILDROOT_VENDOR="swift"
BR2_TARGET_GENERIC_HOSTNAME="swift-linux"
BR2_TARGET_GENERIC_ISSUE="Welcome to Swift Linux"

# Libraries
BR2_PACKAGE_ICU=y
BR2_PACKAGE_LIBBSD=y
BR2_PACKAGE_LIBMD=y
BR2_PACKAGE_LIBXML2=y
BR2_PACKAGE_LIBCURL=y
BR2_PACKAGE_OPENSSL=y

# Swift Runtime Libraries
BR2_PACKAGE_LIBDISPATCH=y
BR2_PACKAGE_SWIFT=y
BR2_PACKAGE_LIBSWIFTDISPATCH=y
BR2_PACKAGE_FOUNDATION=y
BR2_PACKAGE_XCTEST=y

# Misc data
BR2_GENERATE_LOCALE="en_US"
BR2_TARGET_TZ_INFO=y
BR2_PACKAGE_CA_CERTIFICATES=y
```
